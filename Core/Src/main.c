/* USER CODE BEGIN Header */
/**
  ******************************************************************************
  * @file           : main.c
  * @brief          : Main program body
  ******************************************************************************
  * @attention
  *
  * Copyright (c) 2022 STMicroelectronics.
  * All rights reserved.
  *
  * This software is licensed under terms that can be found in the LICENSE file
  * in the root directory of this software component.
  * If no LICENSE file comes with this software, it is provided AS-IS.
  *
  ******************************************************************************
  */
/* USER CODE END Header */
/* Includes ------------------------------------------------------------------*/
#include "main.h"
#include "crc.h"
#include "tim.h"
#include "gpio.h"
#include "math.h"
#include "app_x-cube-ai.h"

/* Private includes ----------------------------------------------------------*/
/* USER CODE BEGIN Includes */
#include "ai_datatypes_defines.h"
#include "ai_platform.h"
#include "network.h"
#include "network_data.h"
#include "stdio.h"
#include "arm_math.h"
/* USER CODE END Includes */

/* Private typedef -----------------------------------------------------------*/
/* USER CODE BEGIN PTD */
	float aiInData[10][AI_NETWORK_IN_1_SIZE]={};
ai_handle network;
float aiOutData[AI_NETWORK_OUT_1_SIZE];
uint8_t activations[AI_NETWORK_DATA_ACTIVATIONS_SIZE];
/* USER CODE END PTD */

/* Private define ------------------------------------------------------------*/
/* USER CODE BEGIN PD */
	/* 模型初始化 */
void net_Init(ai_handle w_addr, ai_handle act_addr)
{
    ai_error err;

    err = ai_network_create(&network, AI_NETWORK_DATA_CONFIG);
    if (err.type != AI_ERROR_NONE) {
        printf("???? - code=%d code=%d\r\n", err.type, err.code);
        Error_Handler();
    }

    const ai_network_params params = AI_NETWORK_PARAMS_INIT(
            AI_NETWORK_DATA_WEIGHTS(w_addr),
            AI_NETWORK_DATA_ACTIVATIONS(act_addr)
    );

    if (!ai_network_init(network, &params)) {
        err = ai_network_get_error(network);
        printf("初始化失败 - code=%d code=%d\r\n", err.type, err.code);
        Error_Handler();
    }
}

/* 模型运行 */
void net_Run(float *pIn, float *pOut)
{
    ai_i32 batch;
    ai_error err;

    ai_buffer ai_input[AI_NETWORK_IN_NUM] = AI_NETWORK_IN;
    ai_buffer ai_output[AI_NETWORK_OUT_NUM] = AI_NETWORK_OUT;

    ai_input[0].n_batches = 1;
    ai_input[0].data = AI_HANDLE_PTR(pIn);
    ai_output[0].n_batches = 1;
    ai_output[0].data = AI_HANDLE_PTR(pOut);

    batch = ai_network_run(network, ai_input, ai_output);
    if (batch != 1) {
        err = ai_network_get_error(network);
        printf("运行失败 - code=%d code=%d\r\n", err.type, err.code);
        Error_Handler();
    }
}

/* USER CODE END PD */

/* Private macro -------------------------------------------------------------*/
/* USER CODE BEGIN PM */
const int LEN=9600; 						// 信号长度
const int fs=96000;							// 采样率
// 0.1s LFM信号
float sig_in[9600]={1.000,0.991,0.966,0.924,0.866,0.793,0.707,0.608,0.499,0.382,0.258,0.129,-0.002,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0.707,0.924};
//float sig_out[9600]={0};
float power=0;
//const int NUM_TAPS=257; 				// 滤波器系数个数
//const float b1[NUM_TAPS]={0.000,0.000,0.000,-0.000,-0.000,-0.000,-0.000,-0.000,0.000,0.000,0.000,0.000,0.000,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0.000,0.000};
//float firState[LEN+NUM_TAPS-1]; // 缓存区
	

const float Pfa=0.02; 					// 虚警概率
float ThresholdEnergy=8.327; 		// 虚警概率对于阈值
int SNR=-5;  										// 信噪比
bool detected=false;
static void test_energy(){
  printf(">>>>>>>>>>>>>>>>>>ENERGY TEST>>>>>>>>>>>>>>>>>>>>>>>>>>>\r\n");
	// 能量检测
	// 测试运行时间
	__HAL_TIM_SetCounter(&htim4,0);
	HAL_TIM_Base_Start(&htim4);
	
	arm_power_f32(sig_in,LEN,&power);
	
	int count_ms=__HAL_TIM_GET_COUNTER(&htim4);
	HAL_TIM_Base_Stop(&htim4);
	
	if(power>ThresholdEnergy){
		printf("detected!!!\r\n");
		detected=true;
	}
	printf("encrgy detect cost: %d ms\r\n\r\n",count_ms);
	// 求功率
	// arm_scale_f32(sig_out,1.0/LEN,sig_out,LEN);
	
}

//static void arm_fir_f32_bp(float *in,float *out) { 
//	uint16_t i; 
//	arm_fir_instance_f32 S; 
//	/* 初始化结构体S */ 
//	arm_fir_init_f32(&S,NUM_TAPS,(float *)b1 ,firState , LEN); 
//	/* 实现FIR滤波 */ 
//	arm_fir_f32(&S,in,out,LEN ); 
//		/* 打印滤波后结果 */ 
//	for(i=0; i<LEN; i++) { 
//		printf("%f,", out[i]); 
//	}
//}
/* USER CODE END PM */

/* Private variables ---------------------------------------------------------*/

/* USER CODE BEGIN PV */
static void test_ai(){
	printf(">>>>>>>>>>>>>>>>>>>AI_TEST>>>>>>>>>>>>>>>>>>>>>>>>>>>>\r\n");
	// 网络初始化
	net_Init(ai_network_data_weights_get(), activations);
	// 测试运行时间
	__HAL_TIM_SetCounter(&htim4,0);
	HAL_TIM_Base_Start(&htim4);
	int i=0,j=0;
	// 填满输入缓冲区
	int cnt=0;
	for(i=0;i<5;i++){
		for(j=0;j<1920;j++){
			aiInData[i][j]=sig_in[j*cnt];
		}
		cnt++;
		net_Run(aiInData[i], aiOutData);
		printf("%d result:\r\n",i);
		for(j=0;j<4;j++){
			printf(" %.3f,",aiOutData[j]);
		}
		printf("\r\n");
	}
	int count_ms=__HAL_TIM_GET_COUNTER(&htim4);
	HAL_TIM_Base_Stop(&htim4);

	printf("computing done\r\n");
	printf("ai run cost: %d ms per time\r\n",count_ms/5);
}

/* USER CODE END PV */

/* Private function prototypes -----------------------------------------------*/
void SystemClock_Config(void);
/* USER CODE BEGIN PFP */

/* USER CODE END PFP */

/* Private user code ---------------------------------------------------------*/
/* USER CODE BEGIN 0 */

/* USER CODE END 0 */

/**
  * @brief  The application entry point.
  * @retval int
  */
int main(void)
{
  /* USER CODE BEGIN 1 */

  /* USER CODE END 1 */

  /* Enable I-Cache---------------------------------------------------------*/
  SCB_EnableICache();

  /* Enable D-Cache---------------------------------------------------------*/
  SCB_EnableDCache();

  /* MCU Configuration--------------------------------------------------------*/

  /* Reset of all peripherals, Initializes the Flash interface and the Systick. */
  HAL_Init();

  /* USER CODE BEGIN Init */

  /* USER CODE END Init */

  /* Configure the system clock */
  SystemClock_Config();

  /* USER CODE BEGIN SysInit */

  /* USER CODE END SysInit */

  /* Initialize all configured peripherals */
  MX_GPIO_Init();
  MX_CRC_Init();
  MX_TIM4_Init();
  MX_X_CUBE_AI_Init();
  /* USER CODE BEGIN 2 */
	test_energy();
	test_ai();
	
	//arm_rfft_fast_f32_test();
  /* USER CODE END 2 */

  /* Infinite loop */
  /* USER CODE BEGIN WHILE */
  while (1)
  {
    /* USER CODE END WHILE */

  //MX_X_CUBE_AI_Process();
    /* USER CODE BEGIN 3 */
//		printf("hello world std\r\n");
//		HAL_Delay(1000);
  }
  /* USER CODE END 3 */
}

/**
  * @brief System Clock Configuration
  * @retval None
  */
void SystemClock_Config(void)
{
  RCC_OscInitTypeDef RCC_OscInitStruct = {0};
  RCC_ClkInitTypeDef RCC_ClkInitStruct = {0};

  /** Supply configuration update enable
  */
  HAL_PWREx_ConfigSupply(PWR_LDO_SUPPLY);
  /** Configure the main internal regulator output voltage
  */
  __HAL_PWR_VOLTAGESCALING_CONFIG(PWR_REGULATOR_VOLTAGE_SCALE0);

  while(!__HAL_PWR_GET_FLAG(PWR_FLAG_VOSRDY)) {}
  /** Initializes the RCC Oscillators according to the specified parameters
  * in the RCC_OscInitTypeDef structure.
  */
  RCC_OscInitStruct.OscillatorType = RCC_OSCILLATORTYPE_HSE;
  RCC_OscInitStruct.HSEState = RCC_HSE_ON;
  RCC_OscInitStruct.PLL.PLLState = RCC_PLL_ON;
  RCC_OscInitStruct.PLL.PLLSource = RCC_PLLSOURCE_HSE;
  RCC_OscInitStruct.PLL.PLLM = 5;
  RCC_OscInitStruct.PLL.PLLN = 192;
  RCC_OscInitStruct.PLL.PLLP = 2;
  RCC_OscInitStruct.PLL.PLLQ = 20;
  RCC_OscInitStruct.PLL.PLLR = 2;
  RCC_OscInitStruct.PLL.PLLRGE = RCC_PLL1VCIRANGE_2;
  RCC_OscInitStruct.PLL.PLLVCOSEL = RCC_PLL1VCOWIDE;
  RCC_OscInitStruct.PLL.PLLFRACN = 0;
  if (HAL_RCC_OscConfig(&RCC_OscInitStruct) != HAL_OK)
  {
    Error_Handler();
  }
  /** Initializes the CPU, AHB and APB buses clocks
  */
  RCC_ClkInitStruct.ClockType = RCC_CLOCKTYPE_HCLK|RCC_CLOCKTYPE_SYSCLK
                              |RCC_CLOCKTYPE_PCLK1|RCC_CLOCKTYPE_PCLK2
                              |RCC_CLOCKTYPE_D3PCLK1|RCC_CLOCKTYPE_D1PCLK1;
  RCC_ClkInitStruct.SYSCLKSource = RCC_SYSCLKSOURCE_PLLCLK;
  RCC_ClkInitStruct.SYSCLKDivider = RCC_SYSCLK_DIV1;
  RCC_ClkInitStruct.AHBCLKDivider = RCC_HCLK_DIV2;
  RCC_ClkInitStruct.APB3CLKDivider = RCC_APB3_DIV2;
  RCC_ClkInitStruct.APB1CLKDivider = RCC_APB1_DIV2;
  RCC_ClkInitStruct.APB2CLKDivider = RCC_APB2_DIV2;
  RCC_ClkInitStruct.APB4CLKDivider = RCC_APB4_DIV2;

  if (HAL_RCC_ClockConfig(&RCC_ClkInitStruct, FLASH_LATENCY_4) != HAL_OK)
  {
    Error_Handler();
  }
}

/* USER CODE BEGIN 4 */

/* USER CODE END 4 */

/**
  * @brief  This function is executed in case of error occurrence.
  * @retval None
  */
void Error_Handler(void)
{
  /* USER CODE BEGIN Error_Handler_Debug */
  /* User can add his own implementation to report the HAL error return state */
  __disable_irq();
  while (1)
  {
  }
  /* USER CODE END Error_Handler_Debug */
}

#ifdef  USE_FULL_ASSERT
/**
  * @brief  Reports the name of the source file and the source line number
  *         where the assert_param error has occurred.
  * @param  file: pointer to the source file name
  * @param  line: assert_param error line source number
  * @retval None
  */
void assert_failed(uint8_t *file, uint32_t line)
{
  /* USER CODE BEGIN 6 */
  /* User can add his own implementation to report the file name and line number,
     ex: printf("Wrong parameters value: file %s on line %d\r\n", file, line) */
  /* USER CODE END 6 */
}
#endif /* USE_FULL_ASSERT */

